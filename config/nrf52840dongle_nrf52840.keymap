#include <behaviors.dtsi>
#include <dt-bindings/zmk/keys.h>

/ {
    keymap {
        compatible = "zmk,keymap";
        label = "Default keymap";
        
        default_layer {
            label = "Default";
            bindings = <&kp A>;
        };
    };
};
