#include <dt-bindings/zmk/matrix_transform.h>

/ {
    split_inputs {
        #address-cells = <1>;
        #size-cells = <0>;

        input_split: input_split@0 {
            compatible = "zmk,input-split";
            reg = <0>;
            status = "okay";
        };
    };

    trackball_listener: trackball_listener {
        compatible = "zmk,input-listener";
        status = "disabled";
        device = <&input_split>;
    };
};