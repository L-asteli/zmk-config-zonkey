## config/boards/shields/zonkey/Kconfig.defconfig
```kconfig
if SHIELD_ZONKEY_R

config ZMK_KEYBOARD_NAME
    default "zonkey_R"

config ZMK_SPLIT
    default y

config ZMK_SPLIT_ROLE_CENTRAL
    default y

endif

if SHIELD_ZONKEY_L

config ZMK_KEYBOARD_NAME
    default "zonkey_L"

config ZMK_SPLIT
    default y

endif

if SHIELD_ZONKEY_DONGLE

config ZMK_KEYBOARD_NAME
    default "zonkey_dongle"

config ZMK_SPLIT
    default y

config ZMK_SPLIT_ROLE_CENTRAL
    default y

# 左右2台をぶら下げる
config ZMK_SPLIT_BLE_CENTRAL_PERIPHERALS
    default 2

# 2 peripherals + BT profiles
# 標準5プロファイルを維持するなら 7
config BT_MAX_CONN
    default 7

config BT_MAX_PAIRED
    default 7

endif
```

## config/boards/shields/zonkey/Kconfig.shield
```kconfig
config SHIELD_ZONKEY_R
    def_bool $(shields_list_contains,zonkey_R)

config SHIELD_ZONKEY_L
    def_bool $(shields_list_contains,zonkey_L)
    
config SHIELD_ZONKEY_DONGLE
    def_bool $(shields_list_contains,zonkey_dongle)
```

## config/boards/shields/zonkey_dongle/Kconfig.defconfig
```kconfig
if SHIELD_ZONKEY_DONGLE

config ZMK_KEYBOARD_NAME
	default "Zonkey Dongle"

# Dongle acts as central for split keyboard
config ZMK_SPLIT
	default y

config ZMK_SPLIT_ROLE_CENTRAL
	default y

# Number of peripheral keyboard halves
config ZMK_SPLIT_BLE_CENTRAL_PERIPHERALS
	default 2

# Bluetooth connection limits
# ZMK_SPLIT_BLE_CENTRAL_PERIPHERALS (2) + default BLE profiles (5) = 7
config BT_MAX_CONN
	default 7

config BT_MAX_PAIRED
	default 7

endif
```
